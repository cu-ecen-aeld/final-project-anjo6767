## base_external/Config.in
```kconfig
menu "Custom external options"
    	source "$BR2_EXTERNAL_project_base_PATH/package/comp-blk-driver/Config.in"
    	source "$BR2_EXTERNAL_project_base_PATH/package/blk-socket/Config.in"
endmenu
```

## base_external/package/blk-socket/Config.in
```kconfig
config BR2_PACKAGE_BLK_SOCKET
	bool "blk-socket"
	help
	  Includes socket for block driver.
```

## base_external/package/comp-blk-driver/Config.in
```kconfig
config BR2_PACKAGE_COMP_BLK_DRIVER
	bool "comp-blk-driver"
	help
	  Includes compression block device driver kernel module.
```

## base_external/package/ldd/Config.in
```kconfig
config BR2_PACKAGE_LDD
    bool "ldd (ldd3 example modules)"
    help
      Build ldd3 kernel modules:
        - misc-modules
        - scull
```
